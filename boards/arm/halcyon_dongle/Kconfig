## boards/arm/halcyon_dongle/Kconfig
```kconfig
# SPDX-License-Identifier: MIT

config BOARD_ENABLE_DCDC
    bool "Enable DCDC mode"
    select SOC_DCDC_NRF52X
    default y
    depends on (BOARD_HALCYON_DONGLE)

config BOARD_ENABLE_DCDC_HV
    bool "High voltage DCDC converter"
    select SOC_DCDC_NRF52X_HV
    default n
    depends on (BOARD_HALCYON_DONGLE)
```

## boards/arm/halcyon_dongle/Kconfig.board
```kconfig
# Copyright (c) 2020 Pete Johanson
# Copyright (c) 2026 Splitkb.com
# SPDX-License-Identifier: Apache-2.0

config BOARD_HALCYON_DONGLE
    bool "Halcyon Wireless Dongle"
	depends on SOC_NRF52840_QIAA
```

## boards/arm/halcyon_wireless/Kconfig
```kconfig
# SPDX-License-Identifier: MIT

config BOARD_ENABLE_DCDC
    bool "Enable DCDC mode"
    select SOC_DCDC_NRF52X
    default y
    depends on (BOARD_HALCYON_WIRELESS)

config BOARD_ENABLE_DCDC_HV
    bool "High voltage DCDC converter"
    select SOC_DCDC_NRF52X_HV
    default n
    depends on (BOARD_HALCYON_WIRELESS)

if BOARD_HALCYON_WIRELESS

# You can add custom board Kconfig prompts here later if needed.
# For now, this empty block anchors the board to Zephyr's build system.

endif # BOARD_HALCYON_WIRELESS
```

## boards/shields/halcyon_corne/Kconfig.shield
```kconfig
# Copyright (c) 2020 Pete Johanson
# Copyright (c) 2026 Splitkb.com
# SPDX-License-Identifier: MIT

config SHIELD_HALCYON_CORNE
    bool

config SHIELD_HALCYON_CORNE_LEFT
    def_bool $(shields_list_contains,halcyon_corne_left)
    select SHIELD_HALCYON_CORNE

config SHIELD_HALCYON_CORNE_RIGHT
    def_bool $(shields_list_contains,halcyon_corne_right)
    select SHIELD_HALCYON_CORNE

config SHIELD_HALCYON_CORNE_DONGLE
    def_bool $(shields_list_contains,halcyon_corne_dongle)
```

## boards/shields/halcyon_elora/Kconfig.shield
```kconfig
# Copyright (c) 2020 Pete Johanson
# Copyright (c) 2026 Splitkb.com
# SPDX-License-Identifier: MIT

config SHIELD_HALCYON_ELORA
    bool

config SHIELD_HALCYON_ELORA_LEFT
    def_bool $(shields_list_contains,halcyon_elora_left)
    select SHIELD_HALCYON_ELORA

config SHIELD_HALCYON_ELORA_RIGHT
    def_bool $(shields_list_contains,halcyon_elora_right)
    select SHIELD_HALCYON_ELORA

config SHIELD_HALCYON_ELORA_DONGLE
    def_bool $(shields_list_contains,halcyon_elora_dongle)
```

## boards/shields/halcyon_ferris/Kconfig.shield
```kconfig
# Copyright (c) 2020 Pete Johanson
# Copyright (c) 2026 Splitkb.com
# SPDX-License-Identifier: MIT

config SHIELD_HALCYON_FERRIS
    bool

config SHIELD_HALCYON_FERRIS_LEFT
    def_bool $(shields_list_contains,halcyon_ferris_left)
    select SHIELD_HALCYON_FERRIS

config SHIELD_HALCYON_FERRIS_RIGHT
    def_bool $(shields_list_contains,halcyon_ferris_right)
    select SHIELD_HALCYON_FERRIS

config SHIELD_HALCYON_FERRIS_DONGLE
    def_bool $(shields_list_contains,halcyon_ferris_dongle)
```

## boards/shields/halcyon_ferris/boards/halcyon_wired.conf
```kconfig
# RGB settings
CONFIG_ZMK_RGB_UNDERGLOW=y
CONFIG_ZMK_RGB_UNDERGLOW_EXT_POWER=n
CONFIG_ZMK_RGB_UNDERGLOW_ON_START=y
CONFIG_ZMK_RGB_UNDERGLOW_BRT_MAX=50
```

## boards/shields/halcyon_kyria/Kconfig.shield
```kconfig
# Copyright (c) 2020 Pete Johanson
# Copyright (c) 2026 Splitkb.com
# SPDX-License-Identifier: MIT

config SHIELD_HALCYON_KYRIA
    bool

config SHIELD_HALCYON_KYRIA_LEFT
    def_bool $(shields_list_contains,halcyon_kyria_left)
    select SHIELD_HALCYON_KYRIA

config SHIELD_HALCYON_KYRIA_RIGHT
    def_bool $(shields_list_contains,halcyon_kyria_right)
    select SHIELD_HALCYON_KYRIA

config SHIELD_HALCYON_KYRIA_DONGLE
    def_bool $(shields_list_contains,halcyon_kyria_dongle)
```

## boards/shields/halcyon_to_promicro/Kconfig.shield
```kconfig
# Copyright (c) 2026 Splitkb.com
# SPDX-License-Identifier: MIT

config SHIELD_HALCYON_TO_PROMICRO
    def_bool $(shields_list_contains,halcyon_to_promicro)
```

## boards/shields/mod_battery_coincell/Kconfig.shield
```kconfig
# Copyright (c) 2026 Splitkb.com
# SPDX-License-Identifier: MIT

config SHIELD_MOD_BATTERY_COINCELL
    def_bool $(shields_list_contains,mod_battery_coincell)
```

## boards/shields/mod_battery_coincell/boards/halcyon_wireless_nrf52840_zmk.conf
```kconfig
CONFIG_ZMK_RGB_UNDERGLOW_AUTO_OFF_USB=y
CONFIG_ZMK_BATTERY_REPORTING_FETCH_MODE_LITHIUM_VOLTAGE=y
```

## boards/shields/mod_battery_lipo/Kconfig.shield
```kconfig
# Copyright (c) 2026 Splitkb.com
# SPDX-License-Identifier: MIT

config SHIELD_MOD_BATTERY_LIPO
    def_bool $(shields_list_contains,mod_battery_lipo)
```

## boards/shields/mod_cirque/Kconfig.shield
```kconfig
# Copyright (c) 2026 Splitkb.com
# SPDX-License-Identifier: MIT

config SHIELD_MOD_CIRQUE_COMMON
    def_bool $(shields_list_contains,mod_cirque_common)
    imply ZMK_POINTING
    imply ZMK_POINTING_SMOOTH_SCROLLING

config SHIELD_MOD_CIRQUE_CENTRAL
    def_bool $(shields_list_contains,mod_cirque_central)
    select SHIELD_MOD_CIRQUE_COMMON

config SHIELD_MOD_CIRQUE_HW_COMMON
    def_bool $(shields_list_contains,mod_cirque_hw_common)
    select SHIELD_MOD_CIRQUE_COMMON

config SHIELD_MOD_CIRQUE_HW_LEFT
    def_bool $(shields_list_contains,mod_cirque_hw_left)
    select SHIELD_MOD_CIRQUE_HW_COMMON

config SHIELD_MOD_CIRQUE_HW_RIGHT
    def_bool $(shields_list_contains,mod_cirque_hw_right)
    select SHIELD_MOD_CIRQUE_HW_COMMON
    
config SHIELD_MOD_CIRQUE_CENTRAL_HW
    def_bool $(shields_list_contains,mod_cirque_central_hw)
    imply ZMK_POINTING
    imply ZMK_POINTING_SMOOTH_SCROLLING
```

## boards/shields/mod_display_epaper/Kconfig.shield
```kconfig
# Copyright (c) 2026 Splitkb.com
# SPDX-License-Identifier: MIT

config SHIELD_MOD_DISPLAY_EPAPER
    def_bool $(shields_list_contains,mod_display_epaper)
```

## boards/shields/mod_display_mip/Kconfig.defconfig
```kconfig
if SHIELD_MOD_DISPLAY_MIP

config LV_Z_VDB_SIZE
    default 100

config LV_DPI_DEF
    default 161

config LV_Z_BITS_PER_PIXEL
    default 1

choice LV_COLOR_DEPTH
    default LV_COLOR_DEPTH_1
endchoice

choice ZMK_DISPLAY_WORK_QUEUE
    default ZMK_DISPLAY_WORK_QUEUE_DEDICATED
endchoice

config ZMK_DISPLAY_STATUS_SCREEN_BUILT_IN
    select LV_FONT_MONTSERRAT_26

endif # SHIELD_MOD_DISPLAY_MIP
```

## boards/shields/mod_display_mip/Kconfig.shield
```kconfig
# Copyright (c) 2026 Splitkb.com
# SPDX-License-Identifier: MIT

config SHIELD_MOD_DISPLAY_MIP
    def_bool $(shields_list_contains,mod_display_mip)
```

## boards/shields/mod_display_tft/Kconfig.shield
```kconfig
# Copyright (c) 2020 Pete Johanson
# SPDX-License-Identifier: MIT

config SHIELD_MOD_DISPLAY_TFT
    def_bool $(shields_list_contains,mod_display_tft)
    imply ZMK_DISPLAY
    imply LV_THEME_DEFAULT_DARK
    imply LV_USE_THEME_DEFAULT
    # For LED control of backlight pin
    select LED
```

## boards/shields/mod_encoder/Kconfig.shield
```kconfig
# Copyright (c) 2026 Splitkb.com
# SPDX-License-Identifier: MIT

config SHIELD_MOD_ENCODER
    bool

config SHIELD_MOD_ENCODER_LEFT
    def_bool $(shields_list_contains,mod_encoder_left)
    select SHIELD_MOD_ENCODER

config SHIELD_MOD_ENCODER_RIGHT
    def_bool $(shields_list_contains,mod_encoder_right)
    select SHIELD_MOD_ENCODER
```
