/*
 * Copyright (c) 2026 Splitkb.com
 *
 * SPDX-License-Identifier: MIT
 */

&kscan_halcyon {
    compatible = "zmk,kscan-gpio-direct";
    wakeup-source;

    input-gpios = <&vik_conn 0 (GPIO_ACTIVE_LOW | GPIO_PULL_UP)>;
};
