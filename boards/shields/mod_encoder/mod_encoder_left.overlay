/*
 * Copyright (c) 2026 Splitkb.com
 *
 * SPDX-License-Identifier: MIT
 */
 
#include "mod_encoder.overlay"

&left_halcyon_encoder {
    a-gpios = <&vik_conn 5 (GPIO_ACTIVE_HIGH | GPIO_PULL_UP)>;
    b-gpios = <&vik_conn 3 (GPIO_ACTIVE_HIGH | GPIO_PULL_UP)>;
    status = "okay";
};
