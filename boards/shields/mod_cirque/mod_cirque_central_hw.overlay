/*
 * Copyright (c) 2026 Splitkb.com
 *
 * SPDX-License-Identifier: MIT
 */

#include "mod_cirque_hw_common.dtsi"

&trackpad {
    invert-x;
};

&trackpad_listener {    
    status = "okay";
    device = <&trackpad>;
};
