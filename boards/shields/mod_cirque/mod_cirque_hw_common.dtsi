/*
 * Copyright (c) 2026 Splitkb.com
 *
 * SPDX-License-Identifier: MIT
 */

&vik_spi {
    status = "okay";
    cs-gpios = <&vik_conn 6 GPIO_ACTIVE_LOW>;
    
    trackpad: trackpad@0 {
        compatible = "cirque,pinnacle";
        reg = <0>;
        spi-max-frequency = <1000000>;
        status = "okay";
        dr-gpios = <&vik_conn 5 GPIO_ACTIVE_HIGH>;

        sensitivity = "2x";
        sleep;
    };
};

&vik_sleep {
    cirque_pins {
        output-gpios = <&vik_conn 6 GPIO_ACTIVE_LOW>;  // CS
    };
};
