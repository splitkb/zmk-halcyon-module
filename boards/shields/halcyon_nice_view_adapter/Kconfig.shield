## boards/shields/halcyon_nice_view_adapter/Kconfig.shield
```kconfig
# Copyright (c) 2022 The ZMK Contributors
# SPDX-License-Identifier: MIT

config SHIELD_HALCYON_NICE_VIEW_ADAPTER
    def_bool $(shields_list_contains,halcyon_nice_view_adapter)
```

## boards/shields/halcyon_sofle_v2/Kconfig.shield
```kconfig
# Copyright (c) 2020 Pete Johanson
# Copyright (c) 2026 Splitkb.com
# SPDX-License-Identifier: MIT

config SHIELD_HALCYON_SOFLE_V2
    bool

config SHIELD_HALCYON_SOFLE_V2_LEFT
    def_bool $(shields_list_contains,halcyon_sofle_v2_left)
    select SHIELD_HALCYON_SOFLE_V2

config SHIELD_HALCYON_SOFLE_V2_RIGHT
    def_bool $(shields_list_contains,halcyon_sofle_v2_right)
    select SHIELD_HALCYON_SOFLE_V2

config SHIELD_HALCYON_SOFLE_V2_DONGLE
    def_bool $(shields_list_contains,halcyon_sofle_v2_dongle)
```
