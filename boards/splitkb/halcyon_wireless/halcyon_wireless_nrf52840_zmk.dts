/*
 * Copyright (c) 2026 Splitkb.com
 *
 * SPDX-License-Identifier: MIT
 */

#include "halcyon_wireless.dts"
#include <common/nordic/nrf52840_uf2_boot_mode.dtsi>

/ {
    EXT_POWER {
        compatible = "zmk,ext-power-generic";
        control-gpios = <&halcyon_conn 32 GPIO_ACTIVE_HIGH>;
        init-delay-ms = <50>;
    };

    vik_sleep: vik_sleep_mgr {
        compatible = "splitkb,vik-sleep";
        status = "okay";
        control-gpios = <&halcyon_conn 33 GPIO_ACTIVE_HIGH>; 
    };
};
