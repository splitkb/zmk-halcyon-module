/*
 * Copyright (c) 2021 Yonatan Schachter
 *
 * SPDX-License-Identifier: Apache-2.0
 */

/dts-v1/;

#include "halcyon_wired.dts"
#include <raspberrypi/rp2040-boot-mode-retention.dtsi>

/ {
	vik_sleep: vik_sleep_mgr {
        compatible = "splitkb,vik-sleep";
        status = "disabled";
    };

	battery_empty_led: battery_empty_led {
        compatible = "splitkb,battery-empty-led";
        status = "disabled";
    };
};
