## boards/splitkb/halcyon_dongle/Kconfig.halcyon_dongle
```kconfig
# Copyright (c) 2020 Pete Johanson
# Copyright (c) 2026 Splitkb.com
# SPDX-License-Identifier: Apache-2.0

config BOARD_HALCYON_DONGLE
	select SOC_NRF52840_QIAA
	imply RETAINED_MEM if BOARD_HALCYON_DONGLE_NRF52840_ZMK
    imply RETENTION if BOARD_HALCYON_DONGLE_NRF52840_ZMK
    imply RETENTION_BOOT_MODE if BOARD_HALCYON_DONGLE_NRF52840_ZMK
```

## boards/splitkb/halcyon_dongle/board.yml
```yaml
board:
  name: halcyon_dongle
  vendor: splitkb
  socs:
    - name: nrf52840
      variants:
        - name: zmk
```

## boards/splitkb/halcyon_wired/Kconfig.defconfig
```kconfig
# Copyright (c) 2021 Pete Johanson
# SPDX-License-Identifier: Apache-2.0

if BOARD_HALCYON_WIRED

config RP2_FLASH_W25Q080
	default y

endif # BOARD_HALCYON_WIRED
```

## boards/splitkb/halcyon_wired/Kconfig.halcyon_wired
```kconfig
# Copyright (c) 2021 Pete Johanson
# SPDX-License-Identifier: Apache-2.0

config BOARD_HALCYON_WIRED
	select SOC_RP2040
    select ZMK_BOARD_COMPAT if BOARD_HALCYON_WIRED_RP2040_ZMK
	imply RETAINED_MEM if BOARD_HALCYON_WIRED_RP2040_ZMK
    imply RETENTION if BOARD_HALCYON_WIRED_RP2040_ZMK
    imply RETENTION_BOOT_MODE if BOARD_HALCYON_WIRED_RP2040_ZMK
```

## boards/splitkb/halcyon_wireless/Kconfig.halcyon_wireless
```kconfig
# Copyright (c) 2020 Pete Johanson
# Copyright (c) 2026 Splitkb.com
# SPDX-License-Identifier: Apache-2.0

config BOARD_HALCYON_WIRELESS
	select SOC_NRF52840_QIAA
	imply RETAINED_MEM
    imply RETENTION
    imply RETENTION_BOOT_MODE
```

## boards/splitkb/halcyon_wireless/board.yml
```yaml
board:
  name: halcyon_wireless
  vendor: splitkb
  socs:
    - name: nrf52840
      variants:
      - name: zmk
```

## boards/splitkb/halcyon_wireless/halcyon_wireless_defconfig
```kconfig
# SPDX-License-Identifier: MIT

# Enable MPU
CONFIG_ARM_MPU=y

# Use pinctrl
CONFIG_PINCTRL=y

# enable GPIO
CONFIG_GPIO=y

# External crystal
CONFIG_CLOCK_CONTROL=y
CONFIG_CLOCK_CONTROL_NRF_K32SRC_XTAL=y
CONFIG_CLOCK_CONTROL_NRF_K32SRC_20PPM=y

CONFIG_USE_DT_CODE_PARTITION=y
CONFIG_BUILD_OUTPUT_UF2=y
```

## config/west.yml
```yaml
manifest:
  remotes:
    - name: splitkb
      url-base: https://github.com/splitkb
    - name: cirque-input-module
      url-base: https://github.com/petejohanson
  projects:
    - name: zmk
      remote: splitkb
      revision: v0.3-branch+halcyon-fixes
      import: app/west.yml
    - name: cirque-input-module
      remote: cirque-input-module
      revision: main
  self:
    path: config
```

## dts/bindings/splitkb,battery-empty-led.yaml
```yaml
# Copyright (c) 2026 splitkb.com
# SPDX-License-Identifier: MIT

description: Battery empty LED control

compatible: "splitkb,battery-empty-led"

properties:
  led:
    type: phandle
    required: true
    description: |
      The LED that is being controlled.

  battery_threshold_percentage:
    type: int
    required: true
    description: |
      Threshold for when the LED should start blinking on boot. In percentages.

  blink_duration_ms:
    type: int
    required: true
    description: |
      Duration of LED being on in milliseconds.

  blink_interval_ms:
    type: int
    required: true
    description: |
      Interval between blinks in milliseconds.

  num_blinks:
    type: int
    required: true 
    description: |
      Number of blinks.
```

## dts/bindings/splitkb,charging-ic-led.yaml
```yaml
# Copyright (c) 2026 splitkb.com
# SPDX-License-Identifier: MIT

description: Charging IC stat pin monitoring and LED control

compatible: "splitkb,charging-ic-led"

properties:
  led:
    type: phandle
    required: true
    description: |
      GPIOs connected to the charging status LEDs.
  
  stat-gpios:
    type: phandle-array
    required: true
    description: |
      GPIO connected to the charging IC status pin.

  stat_assert_delay_ms:
    type: int
    required: true
    description: |
      The number of milliseconds between STAT pin pulses
```

## dts/bindings/splitkb,vik-sleep.yaml
```yaml
description: VIK connector controlled by ZMK sleep state
compatible: "splitkb,vik-sleep"

include: base.yaml

properties:
    control-gpios:
        type: phandle-array
        required: false
        description: The GPIO pin to control

child-binding:
    properties:
        output-gpios:
            type: phandle-array
            required: false
        input-gpios:
            type: phandle-array
            required: false
```

## src/Kconfig
```kconfig
rsource "charging_ic_led/Kconfig"
rsource "battery_empty_led/Kconfig"
rsource "vik_sleep/Kconfig"
```

## src/battery_empty_led/Kconfig
```kconfig
# Copyright (c) 2026 Splitkb.com
# SPDX-License-Identifier: MIT

menuconfig SPLITKB_BATTERY_EMPTY_LED
    bool "Battery Empty LED support"
    default $(dt_compat_enabled,$(DT_COMPAT_SPLITKB_BATTERY_EMPTY_LED))
    select ZMK_BATTERY
    help
        Enable battery empty LED driver for battery monitoring
```

## src/charging_ic_led/Kconfig
```kconfig
# Copyright (c) 2026 Splitkb.com
# SPDX-License-Identifier: MIT

menuconfig SPLITKB_CHARGING_IC_LED
    bool "Charging LED support"
    default $(dt_compat_enabled,$(DT_COMPAT_SPLITKB_CHARGING_IC_LED))
    select ZMK_BATTERY
    help
        Enable charging IC LED driver for battery monitoring
```

## src/vik_sleep/Kconfig
```kconfig
# Copyright (c) 2026 Splitkb.com
# SPDX-License-Identifier: MIT

menuconfig SPLITKB_VIK_SLEEP
    bool "VIK sleep support"
    default $(dt_compat_enabled,$(DT_COMPAT_SPLITKB_VIK_SLEEP))
    depends on ZMK_SLEEP
    help
        Enable VIK control based on ZMK sleep state
```
